#include "scr_noen.h"

#define NUM_SNOW		(15)
#define LOGO_HEIGHT		(4)
#define LOGO_WIDTH		(4)

static const unsigned char PROGMEM logo_merry_chrismast[] = {
	0x00, 0x00, 0x00, 0x00, 0x00, 0x00, 0x00, 0x00, 0x00, 0x00, 0x00, 0x00, 0x00, 0x00, 0x00, 0x00,
	0x00, 0x00, 0x00, 0x00, 0x00, 0x00, 0x00, 0x00, 0x00, 0x00, 0x00, 0x00, 0x00, 0x00, 0x00, 0x00,
	0x00, 0x00, 0x00, 0x00, 0x00, 0x00, 0x00, 0x00, 0x00, 0x00, 0x00, 0x00, 0x00, 0x00, 0x00, 0x00,
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	0x00, 0x00, 0x00, 0x00, 0x00, 0x00, 0x00, 0x00, 0x00, 0x00, 0x00, 0x00, 0x00, 0x00, 0x00, 0x00
};

static const unsigned char PROGMEM snow_icon [] = {
	0x10, 0x54, 0x28, 0xe6, 0x38, 0x54, 0x10
};

int8_t f;
static int8_t icons[NUM_SNOW][3];

static void view_scr_noen();

view_dynamic_t dyn_view_item_merry_christmas = {
	{
		.item_type = ITEM_TYPE_DYNAMIC,
	},
	view_scr_noen
};

view_screen_t scr_noen = {
	&dyn_view_item_merry_christmas,
	ITEM_NULL,
	ITEM_NULL,

	.focus_item = 0,
};

void view_scr_noen() {
	view_render.clear();
	view_render.drawBitmap(0,16,logo_merry_chrismast, 128, 32, 1);
	for(f = 0; f < NUM_SNOW; f++) {
		view_render.drawBitmap( icons[f][XPOS],icons[f][YPOS], snow_icon, 7, 7, WHITE);
	}
	view_render.update();
}

void scr_noen_handle(ak_msg_t* msg) {
	switch (msg->sig) {
	case SCREEN_ENTRY: {
		APP_DBG_SIG("SCREEN_ENTRY\n");
		for(f = 0; f < NUM_SNOW; f++) {
			icons[f][XPOS] = random(1 - LOGO_WIDTH, view_render.width());
			icons[f][YPOS] = -LOGO_HEIGHT;
			icons[f][DELTAY] = random(1, 6);
		}

		timer_set(AC_TASK_DISPLAY_ID, \
				  AC_DISPLAY_SHOW_MERRY_CHRISTMAS_SNOW_MOVING_UPDATE, \
				  AC_DISPLAY_SHOW_MERRY_CHRISTMAS_SNOW_MOVING_UPDATE_INTERAL, \
				  TIMER_PERIODIC);

		BUZZER_PlayTones(tones_merryChrismast);

		timer_set(AC_TASK_DISPLAY_ID, \
				  AC_DISPLAY_SHOW_MERRY_CHRISTMAS_SLEEP, \
				  AC_DISPLAY_SHOW_MERRY_CHRISTMAS_SLEEP_INTERVAL, \
				  TIMER_ONE_SHOT);
	}
		break;

	case AC_DISPLAY_SHOW_MERRY_CHRISTMAS_SNOW_MOVING_UPDATE: {
		for(int i = 0; i < 5; i++) {
			for(f=0; f< NUM_SNOW; f++) {
				icons[f][YPOS] += icons[f][DELTAY];
				if (icons[f][XPOS] >= view_render.width()) {
					icons[f][XPOS] = random(1 - LOGO_WIDTH, view_render.width());
					icons[f][YPOS] = -LOGO_HEIGHT;
					icons[f][DELTAY] = random(1, 6);
				}
			}
		}
	}
		break;

	case AC_DISPLAY_SHOW_MERRY_CHRISTMAS_SLEEP: {
		APP_DBG_SIG("AC_DISPLAY_SHOW_MERRY_CHRISTMAS_SLEEP\n");
		SCREEN_TRAN(scr_idle_handle, &scr_idle);
	}
		break;

	case AC_DISPLAY_BUTON_MODE_RELEASED: {
		APP_DBG_SIG("AC_DISPLAY_BUTON_MODE_RELEASED\n");
		timer_remove_attr(AC_TASK_DISPLAY_ID, AC_DISPLAY_SHOW_MERRY_CHRISTMAS_SNOW_MOVING_UPDATE);
	}
		break;

	case AC_DISPLAY_BUTON_UP_RELEASED: {
		APP_DBG_SIG("AC_DISPLAY_BUTON_UP_RELEASED\n");
		timer_remove_attr(AC_TASK_DISPLAY_ID, AC_DISPLAY_SHOW_MERRY_CHRISTMAS_SNOW_MOVING_UPDATE);
		SCREEN_TRAN(scr_idle_handle, &scr_idle);
	}
		break;

	case AC_DISPLAY_BUTON_DOWN_RELEASED: {
		APP_DBG_SIG("AC_DISPLAY_BUTON_DOWN_RELEASED\n");
		BUZZER_PlayTones(tones_merryChrismast);
	}
		break;

	default:
		break;
	}
}
